#include <dt-bindings/zmk/matrix_transform.h>

/ {
    chosen {
        zmk,kscan = &kscan0;
        zmk,matrix_transform = &default_transform;
    };

    default_transform: keymap_transform_0 {
        compatible = "zmk,matrix-transform";
        columns = <1>;
        rows = <1>;
        // 这里需要根据你的实际按键布局定义矩阵变换
        // 格式: RC(row, col)
        map = <
            RC(0,0)
        >;
    };

    kscan0: kscan_0 {
        compatible = "zmk,kscan-gpio-matrix";
        label = "KSCAN";
        diode-direction = "col2row";

        // 请根据实际硬件连接修改以下引脚
        col-gpios
            = <&pro_micro 15 GPIO_ACTIVE_HIGH>
            ;

        row-gpios
            = <&pro_micro 14 (GPIO_ACTIVE_HIGH | GPIO_PULL_DOWN)>
            ;
    };
};
