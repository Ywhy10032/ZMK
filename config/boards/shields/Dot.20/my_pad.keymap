#include <behaviors.dtsi>
#include <dt-bindings/zmk/keys.h>
#include <dt-bindings/zmk/bt.h>

/ {
    keymap {
        compatible = "zmk,keymap";

        default_layer {
            // 这里定义按键功能，需与 overlay 中的矩阵变换对应
            bindings = <
                &kp A
            >;
        };
    };
};
