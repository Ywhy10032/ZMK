## config/boards/shields/Dot.20/Kconfig.defconfig
```kconfig
# 当检测到 SHIELD_MY_PAD 被启用时，应用以下默认配置
if SHIELD_MY_PAD

config ZMK_KEYBOARD_NAME
    default "My Pad"

endif
```

## config/boards/shields/Dot.20/Kconfig.shield
```kconfig
# 定义 Shield 名称，ZMK 会根据文件名自动匹配
config SHIELD_MY_PAD
    def_bool $(shields_list_contains,my_pad)
```
